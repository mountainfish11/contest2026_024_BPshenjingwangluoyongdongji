## firmware/esp32s3_sub_board/components/atgm336h/Kconfig
```kconfig
menu "ATGM336H GNSS Configuration"

    config ATGM336H_UART_NUM
        int "UART controller"
        range 1 2
        default 1

    config ATGM336H_UART_BAUD_RATE
        int "UART baud rate"
        range 4800 115200
        default 9600
        help
            ATGM336H-5N defaults to 9600 baud. Some newer ATGM336H
            variants default to 115200 baud.

    config ATGM336H_UART_RX_GPIO
        int "Module TXD to controller RX GPIO"
        range 0 48
        default 4

    config ATGM336H_UART_TX_GPIO
        int "Module RXD from controller TX GPIO"
        range 0 48
        default 5

    config ATGM336H_PPS_GPIO
        int "1PPS input GPIO"
        range 0 48
        default 6

endmenu
```

## firmware/esp32s3_sub_board/components/m100m/Kconfig
```kconfig
menu "M100M 4G Transparent UART Configuration"

    config M100M_UART_NUM
        int "UART controller"
        range 1 2
        default 2

    config M100M_UART_BAUD_RATE
        int "UART baud rate"
        range 1200 460800
        default 115200
        help
            This must match the serial configuration in the Yinerda mini app.

    config M100M_UART_RX_GPIO
        int "Module TXD to controller RX GPIO"
        range 0 48
        default 15

    config M100M_UART_TX_GPIO
        int "Module RXD from controller TX GPIO"
        range 0 48
        default 16

endmenu
```

## firmware/esp32s3_sub_board/components/max30102/Kconfig
```kconfig
menu "MAX30102 Heart Rate and SpO2 Sensor Configuration"

    config MAX30102_I2C_PORT
        int "I2C controller"
        default 0
        range 0 1

    config MAX30102_SDA_GPIO
        int "SDA GPIO"
        default 8

    config MAX30102_SCL_GPIO
        int "SCL GPIO"
        default 9

    config MAX30102_INT_GPIO
        int "Active-low interrupt GPIO"
        default 10

    config MAX30102_I2C_FREQUENCY
        int "I2C frequency (Hz)"
        default 400000
        range 100000 400000

    config MAX30102_LED_AMPLITUDE
        hex "Red/IR LED pulse amplitude"
        default 0x24
        range 0x01 0xff
        help
            Each step is approximately 0.2 mA. Start conservatively and tune
            only after inspecting the RED and IR raw values.

    config MAX30102_FINGER_THRESHOLD
        int "IR finger-present threshold"
        default 50000
        range 1000 262143

endmenu
```

## firmware/esp32s3_sub_board/components/vibration_motor/Kconfig
```kconfig
menu "1027 Vibration Motor Configuration"

    config VIBRATION_MOTOR_GPIO
        int "Motor driver control GPIO"
        default 11
        range 0 48
        help
            GPIO connected to the gate/base input of the external motor
            driver.  Never connect the motor directly to this GPIO.

    config VIBRATION_MOTOR_ACTIVE_HIGH
        bool "Motor driver is active high"
        default y

endmenu
```

## firmware/esp32s3_sub_board/main/Kconfig.projbuild
```kconfig
menu "Sub Board Configuration"

    config SUB_BOARD_WIFI_SSID
        string "WiFi SSID"
        default ""
        help
            WiFi SSID for the sub board to connect or host.

    config SUB_BOARD_WIFI_PASSWORD
        string "WiFi Password"
        default ""
        help
            WiFi password for the sub board.

    config SUB_BOARD_MAIN_IP_FALLBACK
        string "Main-board IPv4 fallback"
        default "172.17.159.64"
        help
            Main-board IPv4 address used when the WiFi access point blocks
            UDP broadcast discovery. Leave empty to require discovery.

endmenu
```
